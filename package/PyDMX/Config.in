## package/olad/Config.in
```kconfig
config BR2_PACKAGE_OLAD
	bool "Open Lighting Architecture (OLAD)"
	select BR2_PACKAGE_PROTOBUF
	select BR2_PACKAGE_LIBMICROHTTPD
	help
		The Open Lighting Architecture daemon
```
